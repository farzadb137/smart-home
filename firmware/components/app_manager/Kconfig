## firmware/components/app_manager/Kconfig
```kconfig
menu "app_manager"
    config APP_MANAGER_LOG_VERBOSE
        bool "Verbose logging"
        default n
endmenu
```

## firmware/components/button_manager/Kconfig
```kconfig
menu "button_manager"
    config BUTTON_MANAGER_LOG_VERBOSE
        bool "Verbose logging"
        default n
endmenu
```

## firmware/components/command_manager/Kconfig
```kconfig
menu "command_manager"
    config COMMAND_MANAGER_LOG_VERBOSE
        bool "Verbose logging"
        default n
endmenu
```

## firmware/components/config_manager/Kconfig
```kconfig
menu "config_manager"
    config CONFIG_MANAGER_LOG_VERBOSE
        bool "Verbose logging"
        default n
endmenu
```

## firmware/components/device_info/Kconfig
```kconfig
menu "device_info"
    config DEVICE_INFO_LOG_VERBOSE
        bool "Verbose logging"
        default n
endmenu
```

## firmware/components/drivers/ds18b20/Kconfig
```kconfig
menu "ds18b20"
    config DS18B20_LOG_VERBOSE
        bool "Verbose logging"
        default n
endmenu
```

## firmware/components/led_manager/Kconfig
```kconfig
menu "led_manager"
    config LED_MANAGER_LOG_VERBOSE
        bool "Verbose logging"
        default n
endmenu
```

## firmware/components/logger/Kconfig
```kconfig
menu "logger"
    config LOGGER_LOG_VERBOSE
        bool "Verbose logging"
        default n
endmenu
```

## firmware/components/mqtt_manager/Kconfig
```kconfig
menu "mqtt_manager"
    config MQTT_MANAGER_LOG_VERBOSE
        bool "Verbose logging"
        default n
endmenu
```

## firmware/components/ota_manager/Kconfig
```kconfig
menu "ota_manager"
    config OTA_MANAGER_LOG_VERBOSE
        bool "Verbose logging"
        default n
endmenu
```

## firmware/components/provision_manager/Kconfig
```kconfig
menu "provision_manager"
    config PROVISION_MANAGER_LOG_VERBOSE
        bool "Verbose logging"
        default n
endmenu
```

## firmware/components/sensor_manager/Kconfig
```kconfig
menu "sensor_manager"
    config SENSOR_MANAGER_LOG_VERBOSE
        bool "Verbose logging"
        default n
endmenu
```

## firmware/components/status_manager/Kconfig
```kconfig
menu "status_manager"
    config STATUS_MANAGER_LOG_VERBOSE
        bool "Verbose logging"
        default n
endmenu
```

## firmware/components/system_info/Kconfig
```kconfig
menu "system_info"
    config SYSTEM_INFO_LOG_VERBOSE
        bool "Verbose logging"
        default n
endmenu
```

## firmware/components/telemetry_buffer/Kconfig
```kconfig
menu "telemetry_buffer"
    config TELEMETRY_BUFFER_LOG_VERBOSE
        bool "Verbose logging"
        default n
endmenu
```

## firmware/components/telemetry_manager/Kconfig
```kconfig
menu "telemetry_manager"
    config TELEMETRY_MANAGER_LOG_VERBOSE
        bool "Verbose logging"
        default n
endmenu
```

## firmware/components/time_manager/Kconfig
```kconfig
menu "time_manager"
    config TIME_MANAGER_LOG_VERBOSE
        bool "Verbose logging"
        default n
endmenu
```

## firmware/components/topic_manager/Kconfig
```kconfig
menu "topic_manager"
    config TOPIC_MANAGER_LOG_VERBOSE
        bool "Verbose logging"
        default n
endmenu
```

## firmware/components/wifi_manager/Kconfig
```kconfig
menu "wifi_manager"
    config WIFI_MANAGER_LOG_VERBOSE
        bool "Verbose logging"
        default n
endmenu
```
